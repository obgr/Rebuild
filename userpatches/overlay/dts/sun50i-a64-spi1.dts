/dts-v1/;
/plugin/;

/ {
	compatible = "allwinner,sun50i-a64";

	fragment@0 {
		target-path = "/aliases";
		__overlay__ {
			spi1 = "/soc/spi@1c69000";
		};
	};

	fragment@1 {
		target = <&spi1>;
		__overlay__ {
			#address-cells = <1>;
			#size-cells = <0>;
			status = "okay";
			spidev {
				compatible = "armbian,spi-dev";
				reg = <0>;
				spi-max-frequency = <1000000>;
			};
		};
	};
};