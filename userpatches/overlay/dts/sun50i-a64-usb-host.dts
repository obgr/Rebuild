/dts-v1/;
/plugin/;

/ {
	compatible = "allwinner,sun50i-a64";

	fragment@0 {
		target = <&ehci0>;
		__overlay__ {
			status = "okay";
		};
	};

	fragment@1 {
		target = <&ohci0>;
		__overlay__ {
			status = "okay";
		};
	};

	fragment@2 {
		target = <&usbphy>;
		__overlay__ {
			usb0_vbus-supply = <&reg_usb0_vbus>;
		};
	};
};